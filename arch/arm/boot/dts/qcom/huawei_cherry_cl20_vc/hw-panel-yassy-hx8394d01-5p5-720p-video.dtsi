/* Copyright (c) 2013, The Linux Foundation. All rights reserved.
 *
 * This program is free software; you can redistribute it and/or modify
 * it under the terms of the GNU General Public License version 2 and
 * only version 2 as published by the Free Software Foundation.
 *
 * This program is distributed in the hope that it will be useful,
 * but WITHOUT ANY WARRANTY; without even the implied warranty of
 * MERCHANTABILITY or FITNESS FOR A PARTICULAR PURPOSE.  See the
 * GNU General Public License for more details.
 */

/*---------------------------------------------------------------------------
 * This file is autogenerated file using gcdb parser. Please do not edit it.
 * Update input XML file to add a new entry or update variable in this file
 * VERSION = "1.0"
 *---------------------------------------------------------------------------*/
&mdss_mdp {
	dsi_yassy_hx8394d01_5p5_720p_video: qcom,mdss_dsi_yassy_hx8394d01_5p5_720p_video {
		qcom,mdss-dsi-panel-name = "yassy_hx8394d01_5P5_720P_VIDEO";
		qcom,cont-splash-enabled;
		qcom,mdss-dsi-panel-controller = <&mdss_dsi0>;
		qcom,mdss-dsi-panel-type = "dsi_video_mode";
		qcom,mdss-dsi-panel-destination = "display_1";
		qcom,mdss-dsi-panel-clockrate = <432000000>;
		qcom,mdss-dsi-panel-framerate = <60>;
		qcom,mdss-dsi-virtual-channel-id = <0>;
		qcom,mdss-dsi-stream = <0>;
		qcom,mdss-dsi-panel-width = <720>;
		qcom,mdss-dsi-panel-height = <1280>;
		qcom,mdss-dsi-h-front-porch = <88>;
		qcom,mdss-dsi-h-back-porch = <88>;
		qcom,mdss-dsi-h-pulse-width = <12>;
		qcom,mdss-dsi-h-sync-skew = <0>;
		qcom,mdss-dsi-v-back-porch = <13>;
		qcom,mdss-dsi-v-front-porch = <20>;
		qcom,mdss-dsi-v-pulse-width = <3>;
		qcom,mdss-dsi-h-left-border = <0>;
		qcom,mdss-dsi-h-right-border = <0>;
		qcom,mdss-dsi-v-top-border = <0>;
		qcom,mdss-dsi-v-bottom-border = <0>;
		qcom,mdss-dsi-bpp = <24>;
		qcom,mdss-dsi-underflow-color = <0xff>;
		qcom,mdss-dsi-border-color = <0>;
		qcom,mdss-dsi-color-order = "rgb_swap_rgb";
		qcom,mdss-dsi-on-command = [39 01 00 00 00 00 04 B9 FF 83 94
					39 01 00 00 00 00 03 BA 33 83
					39 01 00 00 00 00 10 B1 6C 12 12 34 04 11 F1 80 E4 93 23 80 C0 D2 58
					39 01 00 00 00 00 0C B2 00 64 10 07 32 1C 08 08 1C 4D 00
					39 01 00 00 00 00 0D B4 00 FF 40 5A 40 5A 43 5A 01 6A 01 6A
					39 01 00 00 00 00 04 BF 41 0E 01
					39 01 00 00 00 00 1F D3 00 06 00 40 07 00 00 32 10 08 00 08 52 15 0F 05 0F 32 10 00 00 00 47 44 0C 0C 47 0C 0C 47
					39 01 00 00 00 00 2D D5 20 21 00 01 02 03 04 05 06 07 18 18 18 18 18 18 18 18 18 18 18 18 18 18 18 18 18 18 18 18 18 18 18 18 18 18 18 18 19 19 18 18 24 25
					39 01 00 00 00 00 2D D6 24 25 07 06 05 04 03 02 01 00 18 18 18 18 18 18 18 18 58 58 18 18 18 18 18 18 18 18 18 18 18 18 18 18 18 18 18 18 18 18 19 19 20 21
					39 01 00 00 00 00 2B E0 00 10 11 3A 3C 3F 1F 41 04 0A 0C 16 0F 13 15 15 16 06 0D 11 17 00 10 11 3A 3C 3F 1F 41 04 0A 0C 16 0F 13 15 15 16 06 0D 11 17
					39 01 00 00 00 00 02 BD 00
					39 01 00 00 00 00 2C C1 01 00 0E 15 1B 25 2E 36 40 4A 52 5A 62 6A 71 78 80 87 8F 98 9F A6 AE B6 BD C4 CC D3 DA E3 EA F0 FA FF 08 9F 7F 00 E3 F0 92 28 C0
					39 01 00 00 00 00 02 BD 01
					39 01 00 00 00 00 2B C1 00 0D 14 19 22 2B 32 3B 44 4C 54 5C 63 6A 70 77 7E 85 8C 94 9C A2 A9 B0 B7 BD C4 CC D2 D9 E0 E7 ED 2B 83 BD C9 08 2B BC 0B C0
					39 01 00 00 00 00 02 BD 02
					39 01 00 00 00 00 2B C1 00 0E 15 1B 25 2E 36 40 4A 52 5A 62 6A 71 78 80 87 8F 98 9F A6 AE B6 BD C4 CC D3 DA E3 EA F0 FA FF 08 9F 7F 00 E3 F0 92 28 C0
					39 01 00 00 00 00 03 C0 30 14
					39 01 00 00 00 00 05 C7 00 C0 40 C0
					39 01 00 00 00 00 02 CC 09
					39 01 00 00 00 00 02 BC 07
					39 01 00 00 00 00 08 C9 1F 00 12 1E 81 1E 00
					39 01 00 00 00 00 02 51 00
					39 01 00 00 00 00 02 53 24
					39 01 00 00 00 00 02 55 01
			                05 01 00 00 78 00 02 11 00
			                05 01 00 00 14 00 02 29 00];
		qcom,mdss-dsi-off-command = [05 01 00 00 14 00 02 28 00
					05 01 00 00 78 00 02 10 00];
		qcom,mdss-dsi-on-command-state = "dsi_lp_mode";
		qcom,mdss-dsi-off-command-state = "dsi_hs_mode";
		qcom,mdss-dsi-h-sync-pulse = <1>;
		qcom,mdss-dsi-traffic-mode = "burst_mode";
		qcom,mdss-dsi-lane-map = "lane_map_0123";
		qcom,mdss-dsi-bllp-eof-power-mode;
		qcom,mdss-dsi-bllp-power-mode;
		qcom,mdss-dsi-lane-0-state;
		qcom,mdss-dsi-lane-1-state;
		qcom,mdss-dsi-lane-2-state;
		qcom,mdss-dsi-lane-3-state;
		qcom,mdss-dsi-panel-timings = [7a 1a 12 00 40 42 16 1e 14 03 04 00];
		qcom,mdss-dsi-t-clk-post = <0x04>;
		qcom,mdss-dsi-t-clk-pre = <0x1c>;
		qcom,mdss-dsi-bl-min-level = <6>;
		qcom,mdss-dsi-bl-max-level = <250>;
		qcom,mdss-dsi-dma-trigger = "trigger_sw";
		qcom,mdss-dsi-mdp-trigger = "none";
		qcom,mdss-dsi-bl-pmic-control-type = "bl_ctrl_dcs";
		qcom,panel-inverse-off-cmds = [05 01 00 00 00 00 02 20 00];
		qcom,panel-inverse-on-cmds = [05 01 00 00 00 00 02 21 00];
		qcom,inverse-on-cmds-dsi-state = "dsi_lp_mode";
		qcom,inverse-off-cmds-dsi-state = "dsi_lp_mode";
		qcom,panel-cabc-ui-cmds = [15 01 00 00 00 00 02 55 01
					15 01 00 00 00 00 02 53 24];
		qcom,panel-cabc-video-cmds = [15 01 00 00 00 00 02 55 03
					15 01 00 00 00 00 02 53 2C];
		qcom,cabc-ui-cmds-dsi-state = "dsi_lp_mode";
		qcom,cabc-video-cmds-dsi-state = "dsi_lp_mode";
		qcom,panel-dot-inversion-mode-cmds = [39 01 00 00 00 00 0C B2 00 64 10 07 32 1C 08 08 1C 4D 00];
		qcom,panel-column-inversion-mode-cmds = [39 01 00 00 00 00 0C B2 00 64 10 07 32 1C 08 08 1C 4D 00];
		qcom,dot-inversion-cmds-dsi-state = "dsi_lp_mode";
		qcom,column-inversion-cmds-dsi-state = "dsi_lp_mode";
		qcom,mdss-dsi-lp11-init;
		qcom,mdss-pan-physical-width-dimension = <68>;
		qcom,mdss-pan-physical-height-dimension = <121>;
		huawei,long-read-flag = <1>;
		huawei,reg-read-expect-value = <0x1C>;
		huawei,reg-long-read-count = <3>;
			qcom,mdss-dsi-reset-sequence = <1 1>, <0 20>, <1 120>;

	};
};
