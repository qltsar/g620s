/* Copyright (c) 2013, The Linux Foundation. All rights reserved.
 *
 * This program is free software; you can redistribute it and/or modify
 * it under the terms of the GNU General Public License version 2 and
 * only version 2 as published by the Free Software Foundation.
 *
 * This program is distributed in the hope that it will be useful,
 * but WITHOUT ANY WARRANTY; without even the implied warranty of
 * MERCHANTABILITY or FITNESS FOR A PARTICULAR PURPOSE.  See the
 * GNU General Public License for more details.
 */

qcom,qrd-4v35-3000mAh-atl-scud-data {
	qcom,fcc-mah = <3000>;
	qcom,default-rbatt-mohm = <143>;
	qcom,rbatt-capacitive-mohm = <50>;
	qcom,flat-ocv-threshold-uv = <3800000>;
	qcom,max-voltage-uv = <4350000>;
	qcom,v-cutoff-uv = <3400000>;
	qcom,chg-term-ua = <100000>;
	qcom,batt-id-kohm = <10>;
	qcom,battery-type = "HB4242B4EBW_ATL_SCUD";

	qcom,warm-bat-decidegc = <420>;
	qcom,warm-bat-mv = <4100>;
	qcom,ibatmax-warm-ma = <800>;

	qcom,cool-bat-decidegc = <100>;
	qcom,cool-bat-mv = <4350>;
	qcom,ibatmax-cool-ma = <600>;

	qcom,hot-bat-decidegc = <520>;
	qcom,cold-bat-decidegc = <0>;
	qcom,rbatt-sf-lut {
		qcom,lut-col-legend = <(-20) 0 25 40 60>;
		qcom,lut-row-legend = <100 95 90 85 80>,
				<75 70 65 60 55>,
				<50 45 40 35 30>,
				<25 20 16 13 11>,
				<10 9 8 7 6>,
				<5 4 3 2 1>,
				<0>;
		qcom,lut-data = <1353 281 100 78 71>,
				<1351 281 100 78 71>,
				<1205 290 102 79 72>,
				<1132 293 104 81 72>,
				<1047 290 107 83 73>,
				<1020 290 113 85 74>,
				<1000 269 119 88 76>,
				<986 263 125 94 80>,
				<1000 258 109 100 84>,
				<1033 255 97 83 73>,
				<1077 253 96 79 72>,
				<1130 251 97 79 72>,
				<1193 251 98 81 74>,
				<1259 267 100 84 76>,
				<1335 298 100 83 77>,
				<1425 337 100 80 72>,
				<1532 376 100 79 72>,
				<1639 418 101 80 72>,
				<1728 465 102 80 72>,
				<1727 479 102 79 72>,
				<1785 497 104 81 72>,
				<1916 521 106 82 74>,
				<2148 551 110 83 74>,
				<2426 585 116 86 75>,
				<2802 620 121 88 76>,
				<3308 658 120 89 75>,
				<4020 700 119 86 74>,
				<5090 763 125 88 75>,
				<6884 864 137 93 79>,
				<14437 3486 955 113 88>,
				<103575 85321 91297 78699 4931>;
	};

	qcom,fcc-temp-lut {
		qcom,lut-col-legend = <(-20) 0 25 40 60>;
		qcom,lut-data = <3033 3037 3037 3038 3027>;
	};

	qcom,pc-temp-ocv-lut {
		qcom,lut-col-legend = <(-20) 0 25 40 60>;
		qcom,lut-row-legend = <100 95 90 85 80>,
				<75 70 65 60 55>,
				<50 45 40 35 30>,
				<25 20 16 13 11>,
				<10 9 8 7 6>,
				<5 4 3 2 1>,
				<0>;
		qcom,lut-data = <4334 4332 4325 4328 4326>,
				<4217 4256 4263 4265 4263>,
				<4136 4194 4206 4207 4205>,
				<4072 4137 4150 4152 4150>,
				<3990 4081 4097 4099 4097>,
				<3937 4028 4048 4049 4047>,
				<3889 3971 4002 4003 4001>,
				<3846 3926 3959 3963 3961>,
				<3821 3886 3908 3922 3922>,
				<3806 3853 3867 3871 3870>,
				<3792 3824 3838 3840 3839>,
				<3777 3799 3815 3816 3815>,
				<3763 3781 3795 3797 3795>,
				<3747 3769 3779 3780 3779>,
				<3732 3758 3765 3764 3762>,
				<3716 3742 3751 3746 3734>,
				<3697 3717 3732 3726 3712>,
				<3678 3697 3708 3704 3691>,
				<3660 3684 3686 3682 3670>,
				<3647 3677 3678 3673 3661>,
				<3639 3672 3676 3671 3660>,
				<3629 3667 3673 3669 3658>,
				<3617 3661 3670 3666 3656>,
				<3601 3653 3665 3663 3652>,
				<3583 3641 3656 3655 3644>,
				<3561 3619 3631 3636 3617>,
				<3530 3581 3585 3595 3572>,
				<3488 3523 3520 3534 3511>,
				<3424 3437 3429 3450 3429>,
				<3307 3300 3292 3322 3303>,
				<3000 3000 3000 3000 3000>;
	};
};
