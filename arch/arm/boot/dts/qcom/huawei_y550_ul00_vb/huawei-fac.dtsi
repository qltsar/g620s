 / {
        huawei_fac_info {
                  compatible = "huawei,hw_fac_info";
                  fac,product_name = "HUAWEI Y550-UL00";
                  fac,hardware_ver = "HL3Y550TM_VERA";
                  fac,software_ver = "MSM8916_Y550-UL00_VB";
                  status = "ok";
        };
};
