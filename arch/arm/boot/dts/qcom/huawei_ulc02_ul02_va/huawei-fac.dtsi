 / {
        huawei_fac_info {
                  compatible = "huawei,hw_fac_info";
                  fac,product_name = "HUAWEI ULC02-UL02";
                  fac,hardware_ver = "HL1ULC02UL02TM";
                  fac,software_ver = "MSM8916_ULC02-UL02_VA";
                  status = "ok";
        };
};
