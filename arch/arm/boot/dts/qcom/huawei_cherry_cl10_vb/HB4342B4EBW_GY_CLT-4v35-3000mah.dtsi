/* Copyright (c) 2013, The Linux Foundation. All rights reserved.
 *
 * This program is free software; you can redistribute it and/or modify
 * it under the terms of the GNU General Public License version 2 and
 * only version 2 as published by the Free Software Foundation.
 *
 * This program is distributed in the hope that it will be useful,
 * but WITHOUT ANY WARRANTY; without even the implied warranty of
 * MERCHANTABILITY or FITNESS FOR A PARTICULAR PURPOSE.  See the
 * GNU General Public License for more details.
 */

qcom,qrd-4v35-3000mAh-clt-data {
	qcom,fcc-mah = <3000>;
	qcom,default-rbatt-mohm = <135>;
	qcom,rbatt-capacitive-mohm = <50>;
	qcom,flat-ocv-threshold-uv = <3800000>;
	qcom,max-voltage-uv = <4350000>;
	qcom,v-cutoff-uv = <3400000>;
	qcom,chg-term-ua = <100000>;
	qcom,batt-id-kohm = <22>;
	qcom,battery-type = "HB4342B4EBW_GY_CLT";

	qcom,warm-bat-decidegc = <420>;
	qcom,warm-bat-mv = <4100>;
	qcom,ibatmax-warm-ma = <800>;

	qcom,cool-bat-decidegc = <100>;
	qcom,cool-bat-mv = <4350>;
	qcom,ibatmax-cool-ma = <600>;

	qcom,hot-bat-decidegc = <520>;
	qcom,cold-bat-decidegc = <0>;
	qcom,rbatt-sf-lut {
		qcom,lut-col-legend = <(-20) 0 25 40 60>;
		qcom,lut-row-legend = <100 95 90 85 80>,
				<75 70 65 60 55>,
				<50 45 40 35 30>,
				<25 20 16 13 11>,
				<10 9 8 7 6>,
				<5 4 3 2 1>,
				<0>;
		qcom,lut-data = <1489 248 100 83 79>,
				<1484 248 100 83 79>,
				<1358 249 99 83 79>,
				<1294 250 100 84 79>,
				<1232 251 102 86 80>,
				<1100 264 108 89 80>,
				<1079 230 109 89 82>,
				<1057 220 117 94 85>,
				<1054 217 109 94 85>,
				<1071 211 96 85 81>,
				<1092 211 94 83 79>,
				<1119 213 95 83 80>,
				<1149 215 96 84 81>,
				<1185 222 97 85 82>,
				<1228 231 97 85 80>,
				<1282 243 96 82 80>,
				<1344 258 97 83 80>,
				<1391 269 97 84 80>,
				<1331 262 96 84 80>,
				<1393 271 97 84 80>,
				<1427 280 97 85 80>,
				<1465 291 99 85 81>,
				<1504 302 100 87 82>,
				<1542 317 102 88 83>,
				<1596 331 102 89 82>,
				<1651 340 100 86 82>,
				<1713 357 102 87 82>,
				<2052 394 107 90 84>,
				<2635 443 116 93 87>,
				<5711 1102 2102 125 102>,
				<98440 64645 51995 26202 17132>;
	};

	qcom,fcc-temp-lut {
		qcom,lut-col-legend = <(-20) 0 25 40 60>;
		qcom,lut-data = <3122 3127 3127 3126 3112>;
	};

	qcom,pc-temp-ocv-lut {
		qcom,lut-col-legend = <(-20) 0 25 40 60>;
		qcom,lut-row-legend = <100 95 90 85 80>,
				<75 70 65 60 55>,
				<50 45 40 35 30>,
				<25 20 16 13 11>,
				<10 9 8 7 6>,
				<5 4 3 2 1>,
				<0>;
		qcom,lut-data = <4336 4335 4329 4331 4328>,
				<4227 4258 4262 4262 4260>,
				<4157 4202 4205 4205 4202>,
				<4107 4150 4151 4150 4148>,
				<4053 4100 4100 4098 4096>,
				<3957 4053 4054 4049 4047>,
				<3913 3970 3991 3997 4002>,
				<3874 3925 3956 3961 3960>,
				<3844 3895 3913 3918 3918>,
				<3824 3863 3870 3872 3872>,
				<3808 3835 3841 3841 3841>,
				<3794 3812 3818 3818 3818>,
				<3780 3794 3800 3800 3799>,
				<3766 3781 3785 3785 3783>,
				<3752 3770 3770 3767 3761>,
				<3736 3757 3754 3747 3735>,
				<3719 3741 3737 3729 3715>,
				<3702 3722 3716 3709 3696>,
				<3687 3706 3697 3691 3678>,
				<3672 3698 3690 3683 3671>,
				<3663 3695 3689 3681 3670>,
				<3652 3692 3687 3680 3669>,
				<3639 3689 3685 3678 3666>,
				<3620 3684 3680 3674 3661>,
				<3598 3672 3665 3664 3645>,
				<3571 3644 3629 3632 3612>,
				<3534 3599 3579 3585 3565>,
				<3486 3539 3513 3526 3504>,
				<3413 3455 3421 3443 3422>,
				<3287 3319 3276 3312 3294>,
				<3000 3000 3000 3000 3000>;
	};
};
