 / {
        huawei_fac_info {
                  compatible = "huawei,hw_fac_info";
                  fac,product_name = "HUAWEI Y550-CL00";
                  fac,hardware_ver = "HL1Y550M_VERA";
                  fac,software_ver = "MSM8916_Y550-CL00_VA";
                  status = "ok";
        };
};
