 / {
        huawei_fac_info {
                  compatible = "huawei,hw_fac_info";
                  fac,product_name = "HUAWEI ULC02-TL";
                  fac,hardware_ver = "HL1ULC02TLTM";
                  fac,software_ver = "MSM8916_ULC02-TL_VA";
                  status = "ok";
        };
};
